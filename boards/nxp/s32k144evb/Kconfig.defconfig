## boards/nxp/s32k144evb/Kconfig.defconfig
```kconfig
# Copyright (c) 2026 Maior Cristian-Alexandru
# SPDX-License-Identifier: Apache-2.0

if BOARD_S32K144EVB

if SERIAL

config UART_CONSOLE
	default y

endif # SERIAL

endif # BOARD_S32K144EVB
```

## boards/nxp/s32k144evb/Kconfig.s32k144evb
```kconfig
# Copyright (c) 2026 Maior Cristian-Alexandru
# SPDX-License-Identifier: Apache-2.0

config BOARD_S32K144EVB
	select SOC_S32K146
	select SOC_PART_NUMBER_FS32K146UAT0VLHT
```

## boards/nxp/s32k144evb/board.yml
```yaml
board:
  name: s32k144evb
  full_name: S32K144EVB-Q100
  vendor: nxp
  socs:
    - name: s32k144
```

## boards/nxp/s32k144evb/s32k144evb_defconfig
```kconfig
# Copyright (c) 2026 Maior Cristian-Alexandru
# SPDX-License-Identifier: Apache-2.0

CONFIG_BUILD_OUTPUT_HEX=y

# Run from internal program flash
CONFIG_XIP=y

CONFIG_ARM_MPU=y

CONFIG_SERIAL=y
CONFIG_CONSOLE=y
```

## boards/nxp/s32k344mini/Kconfig.defconfig
```kconfig
# Copyright (c) 2026 Maior Cristian-Alexandru
# SPDX-License-Identifier: Apache-2.0

if BOARD_S32K344MINI

if SERIAL

config UART_CONSOLE
	default y

endif # SERIAL

if SPI

config SPI_INIT_PRIORITY
	default 50

if WDT_NXP_FS26

config WDT_NXP_FS26_INIT_PRIORITY
	default 51

endif # WDT_NXP_FS26
endif # SPI

endif # BOARD_S32K344MINI
```

## boards/nxp/s32k344mini/board.yml
```yaml
board:
  name: s32k344mini
  full_name: S32K344MINI-EVB (FRDM-A-S32K344)
  vendor: nxp
  socs:
    - name: s32k344
```

## boards/nxp/s32k344mini/s32k344mini_defconfig
```kconfig
# Copyright (c) 2026 Maior Cristian-Alexandru
# SPDX-License-Identifier: Apache-2.0

CONFIG_BUILD_OUTPUT_HEX=y

# Core clock (S32K344 @ 160 MHz)
CONFIG_SYS_CLOCK_HW_CYCLES_PER_SEC=160000000

# Run from internal flash
CONFIG_XIP=y

CONFIG_ARM_MPU=y
CONFIG_NOCACHE_MEMORY=y

CONFIG_SERIAL=y
CONFIG_CONSOLE=y
```
