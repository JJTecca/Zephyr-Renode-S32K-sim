## CMakeLists.txt
```
cmake_minimum_required(VERSION 3.20.0)
find_package(Zephyr REQUIRED HINTS $ENV{ZEPHYR_BASE})

project(sdv_k1_edge)

target_sources(app PRIVATE src/main.c)
target_include_directories(app PRIVATE ${CMAKE_CURRENT_SOURCE_DIR}/../common)
```

## Kconfig
```
# Kconfig — app-level options for the K1 edge node

config SDV_NODE_ID
    int "SDV node ID (1=powertrain, 2=chassis, 3=body, 4=acoustic)"
    default 1
    range 1 4

source "Kconfig.zephyr"
```

## prj.conf
```kconfig
CONFIG_CAN=y
CONFIG_SYS_HEAP_RUNTIME_STATS=y
CONFIG_PRINTK=y
CONFIG_LOG=n
CONFIG_MAIN_STACK_SIZE=2048
CONFIG_HEAP_MEM_POOL_SIZE=16384
CONFIG_REQUIRES_FULL_LIBC=y
CONFIG_REBOOT=y
```

## app.overlay
```dts
/* ADR-017: enable lpuart1 as the inter-node telemetry bus (Renode UART hub
 * stands in for CAN FD in simulation). lpuart2 stays the console. */
&lpuart1 {
	pinctrl-0 = <&lpuart1_default>;
	pinctrl-names = "default";
	clocks = <&clock NXP_S32_LPUART1_CLK>;
	current-speed = <115200>;
	status = "okay";
};
```

## src/main.c
```c
/*****************************************************************************
* File:        main.c
* Description: K1 edge node -- sense-only; streams heap + loop-latency telemetry.
*              NEVER actuates. Emits on console UART, CAN-when-up, and the
*              inter-node link UART (lpuart1, ADR-017). Two injectable faults:
*              memory-leak (accumulating) and timing/deadline-miss (ramping).
* Layer:       firmware/k1_edge (L1 sense + inject)
* Project:     Zephyr-Renode-S32K-sim -- SDV Fault-Prediction & Self-Healing
* Copyright (c) 2026 Maior Cristian-Alexandru
*****************************************************************************/

#include <zephyr/kernel.h>
#include <zephyr/device.h>
#include <zephyr/drivers/can.h>
#include <zephyr/drivers/uart.h>
#include <zephyr/sys/sys_heap.h>
#include <zephyr/sys/reboot.h>
#include "telemetry.h"
#include "actions.h"

#define TICK_MS       100
#define LEAK_HEAP_SZ  8192
#define BUSY_CAP_US   500000u   /* stalling threshold because we dont want to go higher */
#define STAGGER_MS    25        /* senders don't collide */

static struct sdv_fault_ctl volatile sdv_fault_ctl;
static char cmd_buf[48];
static int  cmd_len;

static char leak_buf[LEAK_HEAP_SZ] __aligned(8);
static struct k_heap leak_heap;

static const struct device *can_dev;
static const struct device *link_uart;   /* inter-node telemetry bus (lpuart1) */
static bool     can_ok;
static uint16_t seq;
static size_t   total_leaked;
static uint32_t busy_accum_us;            /* ramping deadline-miss injection */

/* Emit one telemetry record as a text line on the inter-node link UART:
 * "L,node,signal,seq,value\n" -- K3 parses these (ADR-017 transport). */
static void link_emit(uint8_t signal, uint32_t value)
{
    char buf[48];
    int n = snprintk(buf, sizeof(buf), "L,%u,%u,%u,%u\n",
                     (unsigned)CONFIG_SDV_NODE_ID, signal, seq, value);
    for (int i = 0; i < n; i++) {
        uart_poll_out(link_uart, buf[i]);
    }
    printk("K1,tx,link,node=%u,sig=%u,seq=%u,val=%u\n",
           (unsigned)CONFIG_SDV_NODE_ID, signal, seq, value);
}

static void poll_link_cmd(void)
{
    unsigned char c;
    while (link_uart && uart_poll_in(link_uart, &c) == 0) {
        if (c != '\n' && cmd_len < (int)sizeof(cmd_buf) - 1) {
            cmd_buf[cmd_len++] = (char)c;
            continue;
        }
        cmd_buf[cmd_len] = '\0';
        cmd_len = 0;
        if (cmd_buf[0] != 'C' || cmd_buf[1] != ',') {
            continue;
        }
        char *p = cmd_buf + 2;
        /* strtoul = string to unsigned long */
        unsigned long node = strtoul(p, &p, 10); if (*p++ != ',') continue;
        unsigned long act  = strtoul(p, &p, 10);
        if (node != CONFIG_SDV_NODE_ID) {
            continue;
        }
        printk("K1,cmd,node=%lu,action=%lu\n", node, act);
        if (act == SDV_RESTART) {
            sdv_fault_ctl.magic = 0;
            busy_accum_us = 0;
            total_leaked = 0;
            k_heap_init(&leak_heap, leak_buf, LEAK_HEAP_SZ);
            printk("K1,heal,restart\n");
        }
    }
}

static void send_telem(uint8_t signal, uint32_t value)
{
    printk("TELEM,%lld,%u,%u,%u,%u\n",
           k_uptime_get(), (unsigned)CONFIG_SDV_NODE_ID, signal, seq, value);

    if (link_uart) {
        link_emit(signal, value);
    }

    if (can_ok) {
        struct sdv_telem_frame tf = {
            .node = CONFIG_SDV_NODE_ID, .signal = signal,
            .seq = seq, .value = value,
        };
        struct can_frame frame = {
            .id = SDV_CAN_BASE_ID | CONFIG_SDV_NODE_ID,
            .dlc = sizeof(tf), .flags = 0,
        };
        memcpy(frame.data, &tf, sizeof(tf));
        can_send(can_dev, &frame, K_MSEC(50), NULL, NULL);
    }

    seq++;
}

int main(void)
{
    printk("K1,boot,node=%d\n", CONFIG_SDV_NODE_ID);
    k_heap_init(&leak_heap, leak_buf, LEAK_HEAP_SZ);

    /* Inter-node link UART (lpuart1): the sim's stand-in bus (ADR-017). */
    link_uart = DEVICE_DT_GET(DT_NODELABEL(lpuart1));
    if (device_is_ready(link_uart)) {
        printk("K1,link,ok\n");
    } else {
        link_uart = NULL;
        printk("K1,link,unavailable\n");
    }

    can_dev = DEVICE_DT_GET(DT_CHOSEN(zephyr_canbus));
    if (device_is_ready(can_dev)) {
        int ret = can_start(can_dev);
        if (ret == 0 || ret == -EALREADY) {
            can_ok = true;
            printk("K1,can,ok\n");
        } else {
            printk("K1,can,start_err=%d\n", ret);
        }
    } else {
        printk("K1,can,unavailable_sim\n");
    }

    /* #define CONFIG_SDV_NODE_ID 1 */
    k_msleep((CONFIG_SDV_NODE_ID - 1) * STAGGER_MS);
    while (1) {
        poll_link_cmd();
        int64_t t0 = k_uptime_get();
        bool armed = (sdv_fault_ctl.magic == SDV_FAULT_MAGIC);

        /* Fault 1: memory leak (accumulating). */
        if (armed && sdv_fault_ctl.leak_bytes_per_tick > 0) {
            void *p = k_heap_alloc(&leak_heap,
                                   sdv_fault_ctl.leak_bytes_per_tick, K_NO_WAIT);
            if (p) {
                total_leaked += sdv_fault_ctl.leak_bytes_per_tick;
            }
        }

        /* Fault 2: timing / deadline-miss (ramping extra work per tick). */
        if (armed && sdv_fault_ctl.busy_spin_us > 0) {
            busy_accum_us += sdv_fault_ctl.busy_spin_us;
            if (busy_accum_us > BUSY_CAP_US) {
                busy_accum_us = BUSY_CAP_US;
            }
            k_busy_wait(busy_accum_us);
        } else {
            busy_accum_us = 0;   /* clearing the fault heals: latency drops */
        }

        struct sys_memory_stats stats;
        sys_heap_runtime_stats_get(&leak_heap.heap, &stats);
        send_telem(SIG_HEAP_FREE, (uint32_t)stats.free_bytes);
        send_telem(SIG_HEAP_USED, (uint32_t)stats.allocated_bytes);

        /* calculate working delta */
        uint32_t work_ms = (uint32_t)(k_uptime_get() - t0);
        printk("Delta work_ms = %u \n",work_ms);
        send_telem(SIG_LOOP_LATENCY, work_ms);

        k_msleep(TICK_MS);
    }
    return 0;
}
```
